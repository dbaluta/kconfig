## nobloat-imx-defconfig
```kconfig
# CONFIG_ARCH_AGILEX is not set
# CONFIG_ARCH_SUNXI is not set
# CONFIG_ARCH_ALPINE is not set
# CONFIG_ARCH_BCM2835 is not set
# CONFIG_ARCH_BCM_IPROC is not set
# CONFIG_ARCH_BERLIN is not set
# CONFIG_ARCH_BITMAIN is not set
# CONFIG_ARCH_REALTEK is not set
# CONFIG_ARCH_BRCMSTB is not set
# CONFIG_ARCH_EXYNOS is not set
# CONFIG_ARCH_K3 is not set
# CONFIG_ARCH_LAYERSCAPE is not set
# CONFIG_ARCH_LG1K is not set
# CONFIG_ARCH_HISI is not set
# CONFIG_ARCH_MEDIATEK is not set
# CONFIG_ARCH_MESON is not set
# CONFIG_ARCH_MVEBU is not set
# CONFIG_ARCH_QCOM is not set
# CONFIG_ARCH_RENESAS is not set
# CONFIG_ARCH_ROCKCHIP is not set
# CONFIG_ARCH_SEATTLE is not set
# CONFIG_ARCH_STRATIX10 is not set
# CONFIG_ARCH_SYNQUACER is not set
# CONFIG_ARCH_SPRD is not set
# CONFIG_ARCH_TEGRA is not set
# CONFIG_ARCH_THUNDER is not set
# CONFIG_ARCH_THUNDER2 is not set
# CONFIG_ARCH_UNIPHIER is not set
# CONFIG_ARCH_VEXPRESS is not set
# CONFIG_ARCH_XGENE is not set
# CONFIG_ARCH_ZX is not set
# CONFIG_ARCH_ZYNQMP is not set
# CONFIG_ARM_ARMADA_8K_CPUFREQ is not set
# CONFIG_ARM_MEDIATEK_CPUFREQ is not set
# CONFIG_ARM_QCOM_CPUFREQ_KRYO is not set
# CONFIG_ARM_QCOM_CPUFREQ_HW is not set
# CONFIG_VIRTUALIZATION is not set
# CONFIG_BT is not set
# CONFIG_RFKILL is not set
# CONFIG_NET_9P is not set
# CONFIG_DRM is not set
# CONFIG_DRM_DP_CEC is not set
# CONFIG_FB is not set
# CONFIG_IIO is not set
# CONFIG_WIRELESS is not set
# CONFIG_WLAN is not set
# CONFIG_USB_NET_DRIVERS is not set
# CONFIG_ETHERNET is not set
# CONFIG_ATA is not set
# CONFIG_SCSI is not set
# CONFIG_ACPI is not set
# CONFIG_SPMI is not set
# CONFIG_USB_SUPPORT is not set
# CONFIG_MMC is not set
# CONFIG_NEW_LEDS is not set
# CONFIG_MFD_CROS_EC is not set
CONFIG_IMX_DSP=y
```
